#include "pseudo_kb.dtsi"

// Dongle is the central. It receives matrix events from both peripheral halves over BLE
// and processes them through the keymap. No physical kscan, no encoder, no display.
// The matrix transform (from pseudo_kb.dtsi) IS needed to map peripheral events to
// keymap binding positions.

/ {
    kscan0: kscan0 {
        compatible = "zmk,kscan-mock";
        columns = <0>;
        rows = <0>;
        events = <0>;
    };
};
