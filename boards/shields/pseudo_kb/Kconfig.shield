## boards/shields/pseudo_kb/Kconfig.shield
```kconfig
config SHIELD_PSEUDO_KB_LEFT
    def_bool $(shields_list_contains,pseudo_kb_left)

config SHIELD_PSEUDO_KB_RIGHT
    def_bool $(shields_list_contains,pseudo_kb_right)

config SHIELD_PSEUDO_KB_DONGLE
    def_bool $(shields_list_contains,pseudo_kb_dongle)
```
